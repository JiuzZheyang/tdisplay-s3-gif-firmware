## sdkconfig.defaults
```kconfig
# SDKconfig defaults for T-Display-S3 1.9" (ESP32-S3 + 16MB Flash + PSRAM)

# Flash size - 16MB
CONFIG_ESPTOOLPY_FLASHSIZE_16MB=y

# PSRAM
CONFIG_SPIRAM=y
CONFIG_SPIRAM_MODE_OCT=y
CONFIG_SPIRAM_SIZE_8MB=y
CONFIG_SPIRAM_SPEED_80M=y
CONFIG_SPIRAM_BOOT_INIT=y
CONFIG_SPIRAM_FETCH_EXTERNAL_MEMORY=y
CONFIG_SPIRAM_USE_MEMMAP=y

# Partition table - custom SPIFFS at 0x1B0000
CONFIG_PARTITION_TABLE_CUSTOM=y
CONFIG_PARTITION_TABLE_CUSTOM_FILENAME="partitions.csv"

# SPIFFS
CONFIG_SPIFFS_MAX_PARTITIONS=1

# ESP LCD
CONFIG_ESP_LCD_PANEL_IO_ENABLE=y
CONFIG_ESP_LCD_PANEL_ENABLE=y

# Build settings
CONFIG_COMPILER_WARNINGS_AS_ERRORS=n
CONFIG_ESP_CONSOLE_UART_DEFAULT=y
CONFIG_ESPTOOLPY_MONITOR_BAUD_921600B=y
CONFIG_FREERTOS_HZ=1000
CONFIG_FREERTOS_UNICORE=n
CONFIG_ESP_SYSTEM_EVENT_QUEUE_SIZE=32
CONFIG_ESP_SYSTEM_EVENT_TASK_STACK_SIZE=4096
CONFIG_ESP_MAIN_TASK_STACK_SIZE=4096
```
